## Code/mp3_sd_player/project/build_sf32lb52-lchspi-ulp_hcpu/Kconfig
```kconfig
source "$SIFLI_SDK/Kconfig.v2"
source "$SIFLI_SDK/customer/boards/Kconfig.v2"
source "E:/OpenSiFli/sifli-sdk/customer/boards/sf32lb52-lchspi-ulp/hcpu/Kconfig.board"
source "E:/1WOEK/sf32/sifi_mp3_player-master/Code/mp3_sd_player/project/Kconfig.proj"
```

## Code/mp3_sd_player/project/build_sf32lb52-lchspi-ulp_hcpu/bootloader/Kconfig
```kconfig
source "$SIFLI_SDK/Kconfig.v2"
source "$SIFLI_SDK/customer/boards/Kconfig.v2"
source "E:/OpenSiFli/sifli-sdk/customer/boards/sf32lb52-lchspi-ulp/hcpu/Kconfig.board"
source "E:/OpenSiFli/sifli-sdk/example/boot_loader/project/butterflmicro/ram_v2/Kconfig.proj"
```

## Code/mp3_sd_player/project/build_sf32lb52-lchspi-ulp_hcpu/ftab/Kconfig
```kconfig
source "$SIFLI_SDK/Kconfig.v2"
source "$SIFLI_SDK/customer/boards/Kconfig.v2"
source "E:/OpenSiFli/sifli-sdk/customer/boards/sf32lb52-lchspi-ulp/hcpu/Kconfig.board"
source "E:/OpenSiFli/sifli-sdk/example/flash_table/sf32lb52x_common_v2/Kconfig.proj"
```

## Code/mp3_sd_player/project/build_sf32lb52-lchspi-ulp_hcpu/lcpu/Kconfig
```kconfig
source "$SIFLI_SDK/Kconfig.v2"
source "$SIFLI_SDK/customer/boards/Kconfig.v2"
source "E:/OpenSiFli/sifli-sdk/customer/boards/sf32lb52-lchspi-ulp/lcpu/Kconfig.board"
source "E:/OpenSiFli/sifli-sdk/example/ble/lcpu_general/project/common/Kconfig.proj"
```
